## release/src-rt-6.x.4708/linux/linux-2.6.36/arch/arm/plat-brcm/Kconfig
```kconfig
# Broadcom platforms selection

config PLAT_MPCORE
	bool "ARM A9 MPCORE architecture support"
	select CPU_V7
	select ARM_GIC
	select HAVE_ARM_TWD
	select HAVE_ARM_SCU
	select EARLY_PRINTK
	select GENERIC_CLOCKEVENTS_BUILD
	select GENERIC_CLOCKEVENTS
	select LOCAL_TIMERS
	help
	  Support for ARM A9 MPCORE subsystem

config CACHE_L310
	bool "PL310 Level-2 Cache Controller"
        select OUTER_CACHE
        select OUTER_CACHE_SYNC

config PLAT_IPROC
	bool "Broadcom iProc common SoC platform"
	depends on PLAT_MPCORE

config PLAT_IHOST
	bool "Broadcom iHost common SoC peripherals"
	depends on PLAT_IPROC

config PLAT_BCM5301X
	bool "Broadcom BCM5301X SoC support"
	select FPE_FASTFPE
	select COMMON_CLKDEV
	select CACHE_L310 
	select PCI
	select PCI_DOMAINS if PCI
	select ARCH_SPARSEMEM_ENABLE
	select ZONE_DMA if SPARSEMEM
	depends on PLAT_MPCORE
	depends on PLAT_IPROC
	depends on PLAT_IHOST

config ARCH_HAS_HEAD_FIXUP
	bool "Machine needs fixup after the boot monitor"
	help
	Inserts a platform-specific assembly fix-up function
	after boot rom monitor to work around a non-compliant
	boot monitor or certain hardware issues that are not taken
	care of by the boot monitor.

config PLAT_NAND_JFFS2
	bool "BCM5301X NAND Flash driver for JFFS file system"
	depends on PLAT_BCM5301X
	depends on JFFS2_FS
	depends on MTD_NAND
	depends on MTD
	depends on !MTD_BRCMNAND
        depends on !MTD_NFLASH
	help
	Support for JFFS2 on NAND Flash memory connected to the SoC
	NAND controller.

config PLAT_MUX_CONSOLE
	bool "Support UART1(CCA) console"
	depends on PLAT_BCM5301X
	default n
	help
	Using Top-level Muxing to support UART1(CCA) console.  Otherwise default is GPIO pins.
```

## release/src-rt-6.x.4708/linux/linux-2.6.36/drivers/mtd/bcm947xx/Kconfig
```kconfig
menu "Broadcom Flash Devices Support"

if MTD

source "drivers/mtd/bcm947xx/devices/Kconfig"

source "drivers/mtd/bcm947xx/nand/Kconfig"

endif # MTD
endmenu
```

## release/src-rt-7.14.114.x/src/linux/linux-2.6.36/arch/arm/mach-brcm-hnd/Kconfig
```kconfig
if ARCH_BRCM

choice
	prompt "Broadcom ARM Board type"

config MACH_BRCM_NS
	select PLAT_IPROC
	select PLAT_BCM5301x
	select EMBEDDED
	select ARCH_HAS_HEAD_FIXUP
        bool "Northstar ptototype"

config MACH_BRCM_NS_QT
	select PLAT_IPROC
	select PLAT_BCM5301x
	select ARCH_HAS_HEAD_FIXUP
	# select CPU_DCACHE_DISABLE	# D-Cache is broken
	select CPU_DCACHE_WRITETHROUGH	# D-Cache is broken
	# select CPU_BPREDICT_DISABLE	# no BP breaks XIP
	select EMBEDDED
	# select XIP_KERNEL
	# select ZBOOT_ROM - this feature is broken
        bool "Northstar emulation model"

endchoice

config BOARD_ZRELADDR
	hex
	default 0x80208000 if MACH_BRCM_GEN
	default 0x80008000 if MACH_BRCM_NS_QT
	default 0x00008000 if MACH_BRCM_NS
	help
	Must be consistent with the definition of "textaddr-y" in
	arch/arm/Makefile; 
	BOARD_ZRELADDR == virt_to_phys(TEXTADDR)

config BOARD_PARAMS_PHYS
	hex
	default 0x80200000 if MACH_BRCM_GEN
	default 0x80000000 if MACH_BRCM_NS_QT
	default 0x00000000 if MACH_BRCM_NS
   	help
	BOARD_PARAMS_PHYS must be within 4MB of ZRELADDR

config DEBUG_UART_ADDR
	hex
	default 0x18000300 if MACH_BRCM_NS
	default 0x18000300 if MACH_BRCM_NS_QT
	help
	Physical address of the UART used in early kernel debugging.

config DRAM_BASE
	hex "DRAM physical base address"
	default 0x00000000

config XTAL_FREQ
	int "Reference clock frequency (Hz)"
	default 25000000 if MACH_BRCM_NS
	default 17594 if MACH_BRCM_NS_QT

config CR4_OFFLOAD
	bool "CR4 ARM Processor"
	default n

config	HZ
	default 2 if MACH_BRCM_NS_QT
	default 100 if MACH_BRCM_NS

config XIP_PHYS_ADDR
        hex "XIP Kernel Physical Location"
        depends on XIP_KERNEL
        default 0x1e030000 if MACH_BRCM_NS_QT
        default 0x1e040000 if MACH_BRCM_NS

endif
```

## release/src-rt-7.14.114.x/src/linux/linux-2.6.36/arch/arm/plat-brcm/Kconfig
```kconfig
# Broadcom platforms selection

config PLAT_MPCORE
	bool "ARM A9 MPCORE architecture support"
	select CPU_V7
	select ARM_GIC
	select HAVE_ARM_TWD
	select HAVE_ARM_SCU
	select EARLY_PRINTK
	select GENERIC_CLOCKEVENTS_BUILD
	select GENERIC_CLOCKEVENTS
	select LOCAL_TIMERS
	help
	  Support for ARM A9 MPCORE subsystem

config CACHE_L310
	bool "PL310 Level-2 Cache Controller"
        select OUTER_CACHE
        select OUTER_CACHE_SYNC

config PLAT_IPROC
	bool "Broadcom iProc common SoC platform"
	depends on PLAT_MPCORE

config PLAT_IHOST
	bool "Broadcom iHost common SoC peripherals"
	depends on PLAT_IPROC

config PLAT_BCM5301X
	bool "Broadcom BCM5301X SoC support"
	select FPE_FASTFPE
	select COMMON_CLKDEV
	select CACHE_L310 
	select PCI
	select PCI_DOMAINS if PCI
	select ARCH_SPARSEMEM_ENABLE
	select ZONE_DMA if SPARSEMEM
	depends on PLAT_MPCORE
	depends on PLAT_IPROC
	depends on PLAT_IHOST

config ARCH_HAS_HEAD_FIXUP
	bool "Machine needs fixup after the boot monitor"
	help
	Inserts a platform-specific assembly fix-up function
	after boot rom monitor to work around a non-compliant
	boot monitor or certain hardware issues that are not taken
	care of by the boot monitor.

config PLAT_NAND_JFFS2
	bool "BCM5301X NAND Flash driver for JFFS file system"
	depends on PLAT_BCM5301X
	depends on JFFS2_FS
	depends on MTD_NAND
	depends on MTD
	depends on !MTD_BRCMNAND
        depends on !MTD_NFLASH
	help
	Support for JFFS2 on NAND Flash memory connected to the SoC
	NAND controller.

config PLAT_MUX_CONSOLE
	bool "Support UART1(CCA) console"
	depends on PLAT_BCM5301X
	default n
	help
	Using Top-level Muxing to support UART1 on ChipCommonA (CCA) console.  Otherwise default is GPIO pins.

config PLAT_MUX_CONSOLE_CCB
	bool "Support UART0(CCB) console"
	depends on PLAT_BCM5301X
	default n
	help
	Using Top-level Muxing to support UART0 on ChipCommonB (CCB) console.  Otherwise default is GPIO pins.

config PLAT_CCA_GPIO_IRQ
	bool "Support CCA GPIO interrupts"
	depends on PLAT_BCM5301X
	depends on GENERIC_GPIO
	default n
	help
	This should be enabled to support CCA GPIO interrupts.

config PLAT_GPIOLIB
	bool "Support GPIO exporting to user-space"
	depends on PLAT_BCM5301X
	select GENERIC_GPIO
	select GPIOLIB
	select GPIO_SYSFS
	default n
	help
	This should be enabled to support exporting of GPIO to userspace.

config PLAT_GPIOLIB_NAME
	string
	depends on PLAT_GPIOLIB
	default "gpiolib"

config PLAT_UART_CLOCKS
	bool "Precise configuration of UART clocks and dividers"
	depends on PLAT_BCM5301X
	default n

choice
	prompt "Clock source for ChipCommon_A UART"
	depends on PLAT_UART_CLOCKS
	default PLAT_CCA_UART_CLK_DEFAULT

config PLAT_CCA_UART_CLK_DEFAULT
	bool "Use after reset default settings"

config PLAT_CCA_UART_CLK_INTERNAL_OVERRIDE
	bool "ALP(APB) (125Mhz as for now) clock used as CCA UARTs clock"

config PLAT_CCA_UART_CLK_INTERNAL_DIVIDER
	bool "ALP(APB) (125Mhz as for now) clock with divider applied used as CCA UARTs clock"
	help
	   CCA UARTs clock will be ALB(APB) divided by PLAT_CCA_UART_CLK_INTERNAL_DIVIDER_VAL

config PLAT_CCA_UART_CLK_EXTERNAL
	bool "External 25Mhz clock used as CCA UARTs clock"

endchoice

config PLAT_CCA_UART_CLK_INTERNAL_DIVIDER_VAL
	int "Divider value"
	depends on PLAT_CCA_UART_CLK_INTERNAL_DIVIDER
	default 48

config PLAT_CCA_UART0_DIVIDER
	int "Divider value for CCA UART0"
	depends on PLAT_UART_CLOCKS
	help
	  If requested baud rate is 38400, it will be ignored and this divider be used instead.
	  Baud rate will be CCA UARTs clock divided by 16 and then divided by current value.
	  Divider is 16 bit, so default setting above maximum 16 bit value switch off this feature.
	default 65536

config PLAT_CCA_UART1_DIVIDER
	int "Divider value for CCA UART1"
	depends on PLAT_UART_CLOCKS
	help
	  If requested baud rate is 38400, it will be ignored and this divider be used instead.
	  Baud rate will be CCA UARTs clock divided by 16 and then divided by current value.
	  Divider is 16 bit, so default setting above maximum 16 bit value switch off this feature.
	default 65536

config PLAT_CCB_UART0_DIVIDER
	int "Divider value for CCA UART0"
	depends on PLAT_UART_CLOCKS
	help
	  If requested baud rate is 38400, it will be ignored and this divider be used instead.
	  Baud rate will be CCB UART clock divided by 16 and then divided by current value.
	  Divider is 16 bit, so default setting above maximum 16 bit value switch off this feature.
	  CCB UART clock is always same - ALP(APB) (125Mhz as for now) clock.
	default 65536
```

## release/src-rt-7.14.114.x/src/linux/linux-2.6.36/arch/mips/brcm-boards/Kconfig
```kconfig
menu "Support for Broadcom MIPS based boards"

config BCM947XX
        bool "Support for Broadcom BCM947XX"
        depends on MIPS_BRCM
	default y

#config BCM47XX
#        bool "Support for Broadcom BCM47XX processors"
#        depends on BCM947XX

config BCMIPDSCP
        bool "Support for Using DSCP based IP forwarding"
        depends on BCM947XX

config HND_BMIPS3300_PROF
        bool "Support for performance profiling"
        depends on BCM947XX

config RAM_SIZE
        int "Memory size (in megabytes)"
        depends on BCM947XX

config SHRINKMEM
        bool "Support for shrink memory"
        depends on BCM947XX
        select PM

config GENERIC_GPIO
        bool "Generic GPIO"
        default n

config CROSS_COMPILE
	default "mipsel-uclibc-linux26-"

endmenu
```

## release/src-rt-7.14.114.x/src/linux/linux-2.6.36/drivers/net/hnd/Kconfig
```kconfig
#
# Broadcom Home Networking Division (HND) driver configuration
#
# $Copyright Open Broadcom Corporation$
#
# $Id: Kconfig,v 1.6 2010-07-05 07:01:45 chihsien Exp $
#

menu "Broadcom HND network devices"
	depends on PCI
config HND
	bool "Broadcom HND network device support"
config ET
	tristate "10/100 Ethernet support"
	depends on HND
config ET_47XX
	bool "BCM47xx support"
	depends on ET
choice
	prompt "ET ALL PASSIVE mode"
	depends on ET
	
config ET_ALL_PASSIVE_ON
	bool "ET ALL PASSIVE on"
config ET_ALL_PASSIVE_RUNTIME
	bool "ET ALL PASSIVE with runtime setting"
endchoice
config BCM_AGG
	bool "BCM HW Port Trunking/Aggregation support"
	depends on HND
config BCM_CTF
	tristate "BCMCTF support"
	depends on HND
config BCM_FA
	bool "BCM HW Flow Accelerator support"
	depends on BCM_CTF
config BCM_GMAC3
	bool "BCM 3 GMAC Forwarding support"
	depends on BCM_CTF
config WL_EMULATOR
	bool "WL emulation using Gigabit ethernet"
	depends on HND
config BCM57XX
	tristate "BCM57xx support is ON"
	depends on WL_EMULATOR
config WL
	tristate "Wireless feature variant is set to AP"
	depends on WL_EMULATOR
	select WL_USE_AP
config BCM57XX
	tristate "BCM57xx Gigabit Ethernet support"
	depends on HND && !WL_EMULATOR
config DHDAP
	tristate "BCM DHD support"
	depends on HND && !WL_EMULATOR
config WL
	tristate "BCM43xx 802.11 Wireless support"
	depends on HND && !WL_EMULATOR
config WAPI
	bool "Wireless Authentication Privacy Infrastructure (WAPI) support"
	depends on HND && !WL_EMULATOR && WL
	select MTD_BCMCONF_PARTS
choice
	prompt "Wireless feature variant"
	depends on HND && !WL_EMULATOR && WL
config WL_USE_AP
	bool "Config file for basic AP variant"
config WL_USE_AP_SDSTD
	bool "Config file for basic AP sdstd variant"
config WL_USE_STA
	bool "Config file for basic STA variant"
config WL_USE_APSTA
	bool "Config file for basic APSTA variant"
config WL_USE_AP_ONCHIP_G
	bool "Config file for AP 1chipG variant"
config WL_USE_STA_ONCHIP_G
	bool "Config file for STA 1chipG variant"
config WL_USE_APSTA_ONCHIP_G
	bool "Config file for APSTA 1chipG variant"
endchoice
config WL_USBAP
	bool "USB/HSIC Wireless Access Point support"
#if defined(WLSRC) || defined(PREBUILD)
config WL_AP 
	string "Config file for basic AP variant"
	default "wlconfig_lx_router_ap"
config WL_AP_SDSTD
	string "Config file for basic AP sdstd variant"
	default "wlconfig_lx_router_ap_sdstd"
config WL_STA 
	string "Config file for basic STA variant"
	default "wlconfig_lx_router_sta"
config WL_APSTA 
	string "Config file for basic APSTA variant"
	default "wlconfig_lx_router_apsta"
config WL_AP_ONCHIP_G 
	string "Config file for AP 1chipG variant"
	default "wlconfig_lx_router_ap_1chipG"
config WL_STA_ONCHIP_G 
	string "Config file for STA 1chipG variant"
	default "wlconfig_lx_router_sta_1chipG"
config WL_HIGH 
	string "Config file for high/bmac split variant"
	default "wlconfig_lx_router_high"

choice
	prompt "WL ALL PASSIVE mode"
	depends on WL
	
config WL_ALL_PASSIVE_ON
	bool "WL ALL PASSIVE on"
config WL_ALL_PASSIVE_RUNTIME
	bool "WL ALL PASSIVE with runtime setting"
endchoice
#endif
config DPSTA
	tristate "Broadcom dualband wireless proxy repeater support"
	depends on WL
config LACP
	tristate "Broadcom lacp support"
config EMF
	tristate "Efficient Multicast Forwarding & IGMP Snooping Layers"
	depends on NETFILTER
endmenu
```

## release/src-rt-7.x.main/src/linux/linux-2.6.36/arch/arm/plat-brcm/Kconfig
```kconfig
# Broadcom platforms selection

config PLAT_MPCORE
	bool "ARM A9 MPCORE architecture support"
	select CPU_V7
	select ARM_GIC
	select HAVE_ARM_TWD
	select HAVE_ARM_SCU
	select EARLY_PRINTK
	select GENERIC_CLOCKEVENTS_BUILD
	select GENERIC_CLOCKEVENTS
	select LOCAL_TIMERS
	help
	  Support for ARM A9 MPCORE subsystem

config CACHE_L310
	bool "PL310 Level-2 Cache Controller"
        select OUTER_CACHE
        select OUTER_CACHE_SYNC

config PLAT_IPROC
	bool "Broadcom iProc common SoC platform"
	depends on PLAT_MPCORE

config PLAT_IHOST
	bool "Broadcom iHost common SoC peripherals"
	depends on PLAT_IPROC

config PLAT_BCM5301X
	bool "Broadcom BCM5301X SoC support"
	select FPE_FASTFPE
	select COMMON_CLKDEV
	select CACHE_L310 
	select PCI
	select PCI_DOMAINS if PCI
	select ARCH_SPARSEMEM_ENABLE
	select ZONE_DMA if SPARSEMEM
	depends on PLAT_MPCORE
	depends on PLAT_IPROC
	depends on PLAT_IHOST

config ARCH_HAS_HEAD_FIXUP
	bool "Machine needs fixup after the boot monitor"
	help
	Inserts a platform-specific assembly fix-up function
	after boot rom monitor to work around a non-compliant
	boot monitor or certain hardware issues that are not taken
	care of by the boot monitor.

config PLAT_NAND_JFFS2
	bool "BCM5301X NAND Flash driver for JFFS file system"
	depends on PLAT_BCM5301X
	depends on JFFS2_FS
	depends on MTD_NAND
	depends on MTD
	depends on !MTD_BRCMNAND
        depends on !MTD_NFLASH
	help
	Support for JFFS2 on NAND Flash memory connected to the SoC
	NAND controller.

config PLAT_MUX_CONSOLE
	bool "Support UART1(CCA) console"
	depends on PLAT_BCM5301X
	default n
	help
	Using Top-level Muxing to support UART1 on ChipCommonA (CCA) console.  Otherwise default is GPIO pins.

config PLAT_MUX_CONSOLE_CCB
	bool "Support UART0(CCB) console"
	depends on PLAT_BCM5301X
	default n
	help
	Using Top-level Muxing to support UART0 on ChipCommonB (CCB) console.  Otherwise default is GPIO pins.

config PLAT_CCA_GPIO_IRQ
	bool "Support CCA GPIO interrupts"
	depends on PLAT_BCM5301X
	depends on GENERIC_GPIO
	default n
	help
	This should be enabled to support CCA GPIO interrupts.

config PLAT_GPIOLIB
	bool "Support GPIO exporting to user-space"
	depends on PLAT_BCM5301X
	select GENERIC_GPIO
	select GPIOLIB
	select GPIO_SYSFS
	default n
	help
	This should be enabled to support exporting of GPIO to userspace.

config PLAT_GPIOLIB_NAME
	string
	depends on PLAT_GPIOLIB
	default "gpiolib"
```

## release/src-rt-7.x.main/src/linux/linux-2.6.36/drivers/mtd/bcm947xx/Kconfig
```kconfig
menu "Broadcom Flash Devices Support"

if MTD

config MTD_BCMCONF_PARTS
	bool "Broadcom confmtd partition"
	depends on !MTD_BRCMNAND && MTD_BCMSFLASH

source "drivers/mtd/bcm947xx/devices/Kconfig"

source "drivers/mtd/bcm947xx/nand/Kconfig"

endif # MTD
endmenu
```

## release/src-rt-7.x.main/src/linux/linux-2.6.36/drivers/mtd/bcm947xx/devices/Kconfig
```kconfig
#
# linux/drivers/mtd/bcm947xx/devices/Kconfig
#

config MTD_BCMSFLASH
	bool "Broadcom Serial Flash support"
```
