## release/src/router/config/config.in
```kconfig
mainmenu "Router Configuration"

config RTCONFIG_OPTIMIZE_SHARED_LIBS
	bool "Optimize shared libraries (remove unused symbols)"
	default y

config RTCONFIG_L2TP
	bool "L2TP"
	default y

config RTCONFIG_PPTP
	bool "PPTP"
	default y

config RTCONFIG_EAPOL
	bool "EAPOL"
	default y

config RTCONFIG_TELENET
	bool "TELENET"
	default y

config RTCONFIG_PPTPD
	bool "PPTPD"
	default n

config RTCONFIG_ACCEL_PPTPD
	bool "ACCEL_PPTPD"
	default n

config RTCONFIG_SNMPD
	bool "SNMPD"
	default n

config RTCONFIG_HTTPS
	bool "HTTPS"
	default y

config RTCONFIG_BCMARM
	bool "Bcm Arm"
	default n

config RTCONFIG_BCM7
	bool "Bcm sdk 7"
	default n

config RTCONFIG_BCM_794
	bool "Bcm sdk 7_14_94_x"
	default n

config RTCONFIG_BCM_7114
	bool "Bcm sdk 7_14_114_x"
	default n

config RTCONFIG_BCM10
	bool "Bcm sdk 10_10_18_x"
	default n

config RTCONFIG_BCM9
	bool "Bcm sdk 9_10_162_x"
	default n

config RTCONFIG_BUILDBCM7
	bool "build Bcm sdk 7 on 6 platforms"
	default n

config RTCONFIG_ROMCFE
	bool "fw include cfe"
	default n

config RTCONFIG_ROMATECCODEFIX
	bool "fix ccode error"
	default n

config RTCONFIG_NV128
	bool "nvram size 128k"
	default n

config RTCONFIG_DHDAP
	bool "Bcm7 dhdap"
	default n

config RTCONFIG_WLEXE
	bool "dhd wl exe"
	default n

config RTCONFIG_DPSTA
	bool "Bcm7 dpsta"
	default n

config RTCONFIG_GMAC3
	bool "Bcm7 gmac3"
	default n

config RTCONFIG_BCMSMP
	bool "BCM SMP"
	default n

config RTCONFIG_BCMFA
	bool "BCM FA"
	default n

config RTCONFIG_RGMII_BCM_FA
	bool "BCM FA on RGMII hardware"
	default n

config RTCONFIG_5301X
	bool "Bcm 5301x"
	default y

config RTCONFIG_4352_5G
	bool "4352 needs"
	default y

config RTCONFIG_SSH
	bool "SSH"
	default y

config RTCONFIG_CIFS
	bool "CIFS Client"
	default y

config RTCONFIG_BRCM_NAND_JFFS2
	bool "JFFS Support on BRCM Nand Flash Partition"
	default n

config RTCONFIG_JFFS2
	bool "JFFS Support"
	default n

config RTCONFIG_DISKTEST
	bool "Disk test tools"
	default n

config RTCONFIG_JFFSV1
	bool "Use JFFSv1 (if not selected, JFFS2 is used)"
	depends on RTCONFIG_JFFS2
	default y

config RTCONFIG_ZEBRA
	bool "Zebra"
	default n

config RTCONFIG_QUAGGA
	bool "Quagga"
	default n

config RTCONFIG_DDNS
	bool "Dynamic DNS"
	default y

config RTCONFIG_L7
	bool "Layer 7 Netfilter"
	default y

config RTCONFIG_L7PAT
	bool "Standard Layer 7 Patterns"
	depends on RTCONFIG_L7
	default y

config RTCONFIG_LZO
	bool "LZO Compression"
	default n

config RTCONFIG_OPENVPN
	bool "OpenVPN"
	depends on RTCONFIG_LZO
	default n

config RTCONFIG_IPSEC
	bool "IPsec"
	default n

# !!TB
config RTCONFIG_IPV6
	bool "IPv6 Support"
	default n

config RTCONFIG_EBTABLES
	bool "Ebtables"
	default n

config RTCONFIG_EMF
	bool "Broadcom EMF (Efficient Multicast Forwarding & IGMP Snooping)"
	default n

config RTCONFIG_BCMBSD
	bool "Brcm Band Steer Selection"
	default n

config RTCONFIG_BCMSSD
	bool "SSID Steer Daemon"
	default n

config RTCONFIG_BCMDCS
	bool "Broadcom Dynamic Channel Selection"
	default n

config RTCONFIG_TRAFFIC_MGMT_RSSI_POLICY
	bool "Traffic Management RSSI policy"
	default n

config RTCONFIG_TOAD
	bool "Traffic Ordering Agent Daemon"
	default n

config RTCONFIG_HSPOT
	bool "HOTSPOT 2.0 support"
	default n

config RTCONFIG_FANCTRL
	bool "Fan Control Function"
	default n

config RTCONFIG_BCMWL6
	bool "BCM WL 6"
	default n

config RTCONFIG_BCMWL6A
	bool "BCM WL 6.30.143"
	depends on RTCONFIG_BCMARM && RTCONFIG_BCMWL6
	default n

config RTCONFIG_WIRELESSWAN
	bool "Wireless WAN Function"
	default n

config RTCONFIG_WIRELESSREPEATER
	bool "Repeater Mode"
	default n

config RTCONFIG_DISABLE_REPEATER_UI
	bool "Hiden UI Repeater Mode"
	default n

config RTCONFIG_PROXYSTA
	bool "Proxy STA"
	default n

config RTCONFIG_CONCURRENTREPEATER
	bool "Concurrent Repeater"
	default n

config RTCONFIG_IXIAEP
	bool "IXIA Performance Endpoint"
	default n

config RTCONFIG_IPERF
	bool "Iperf"
	default n

config RTCONFIG_TCPDUMP
	bool "tcpdump"
	default n

config RTCONFIG_PARENTALCTRL
	bool "Parental Control Function"
	default n

config RTCONFIG_YANDEXDNS
	bool "Yandex.DNS Support"
	depends on !RTCONFIG_DNSFILTER
	default n

config RTCONFIG_DSL
	bool "DSL Support"
	default n

config RTCONFIG_DSL_ANNEX_B
	bool "DSL Annex B Support"
	default n

config RTCONFIG_DSL_TCLINUX
	bool "DSL Support with TCLINUX"
	default n

config RTCONFIG_VDSL
	bool "VDSL Support"
	default n

config RTCONFIG_DUALWAN
	bool "Dual WAN Support"
	default n

config RTCONFIG_HW_DUALWAN
	bool "Dual WAN with Support"
	default n

config RTCONFIG_USER_LOW_RSSI
	bool "User specified accepted min rssi"
	default n

config RTCONFIG_NEW_USER_LOW_RSSI
	bool "User specified accepted min rssi"
	default n

config RTCONFIG_PUSH_EMAIL
	bool "Push Mail Service Support"
	default n

config RTCONFIG_USB
	bool "USB Support"
	default y

config RTCONFIG_USBRESET
	bool "USB Power Reset Support"
	default n

config RTCONFIG_WIFIPWR
	bool "WIFI Power option"
	default n

config RTCONFIG_LEDARRAY
	bool "wifi led array support"
	default n

config RTCONFIG_XHCIMODE
	bool "XHCI mode Support"
	default n

config RTCONFIG_MEDIA_SERVER
	bool "Media Server (MiniDLNA)"
	depends on RTCONFIG_USB
	default n

config RTCONFIG_CLOUDSYNC
	bool "Cloudsync (Cloud Client)"
	depends on RTCONFIG_USB
	default n

config RTCONFIG_SWEBDAVCLIENT
	bool "webdavsync (webdav Client)"
	depends on RTCONFIG_CLOUDSYNC
	default n

config RTCONFIG_DROPBOXCLIENT
	bool "Dropboxsync (dropbox Client)"
	depends on RTCONFIG_CLOUDSYNC
	default n

config RTCONFIG_FTPCLIENT
	bool "FTPSync (ftp Client)"
	depends on RTCONFIG_CLOUDSYNC
	default n

config RTCONFIG_SAMBACLIENT
	bool "SambaSync (samba Client)"
	depends on RTCONFIG_CLOUDSYNC
	default n

config RTCONFIG_USBCLIENT
	bool "UsbSync (usb Client)"
	depends on RTCONFIG_CLOUDSYNC
	default n

config RTCONFIG_FLICKRCLIENT
	bool "FlickrSync (flickr Client)"
	depends on RTCONFIG_CLOUDSYNC
	default n

config RTCONFIG_FTP
	bool "FTP Server"
	depends on RTCONFIG_USB
	default y

config RTCONFIG_FTP_SSL
	bool "FTP SSL Support"
	depends on RTCONFIG_USB && RTCONFIG_FTP
	default n

config RTCONFIG_WEBDAV
	bool "WebDav Support"
	depends on RTCONFIG_USB
	default n

config RTCONFIG_SAMBASRV
	bool "Samba File Sharing"
	depends on RTCONFIG_USB
	default y

config RTCONFIG_SAMBA3
	bool "Compile with Samba 3"
	depends on RTCONFIG_SAMBASRV
	default n

config RTCONFIG_SAMBA_MODERN
        bool "Compile with modern Samba 3.6.x"
        depends on RTCONFIG_SAMBASRV
        default n

config RTCONFIG_NFS 
	bool "NFS Support" 
	depends on RTCONFIG_USB
	default n

config RTCONFIG_IGD2
	bool "UPNP: IGD2 support"
	default n

config RTCONFIG_USB_EXTRAS
	bool "Additional modules and utilities"
	depends on RTCONFIG_USB
	default n

config RTCONFIG_TFAT
	bool "Tuxera FAT module Support"
	depends on RTCONFIG_USB
	default n

config RTCONFIG_NTFS
	bool "NTFS Support"
	depends on RTCONFIG_USB
	default n

config RTCONFIG_PARAGON_NTFS
	bool "NTFS Support by Paragon"
	depends on RTCONFIG_NTFS
	default n

config RTCONFIG_TUXERA_NTFS
	bool "NTFS Support by Tuxera"
	depends on RTCONFIG_NTFS
	default n

config RTCONFIG_OPEN_NTFS3G
	bool "NTFS-3G Support"
	depends on RTCONFIG_NTFS
	default n

config RTCONFIG_HFS
	bool "HFS Support"
	depends on RTCONFIG_USB
	default n

config RTCONFIG_PARAGON_HFS
	bool "HFS Support by Paragon"
	depends on RTCONFIG_HFS
	default n

config RTCONFIG_TUXERA_HFS
	bool "HFS Support by Tuxera"
	depends on RTCONFIG_HFS
	default n

config RTCONFIG_KERNEL_HFSPLUS
	bool "Kernel HFSPLUS support"
	depends on RTCONFIG_HFS
	default n

config RTCONFIG_UFSD_DEBUG
	bool "ufsd debug Support"
	depends on RTCONFIG_PARAGON_NTFS || RTCONFIG_PARAGON_HFS
	default n

config RTCONFIG_DISK_MONITOR
	bool "Disk monitor Support"
	depends on RTCONFIG_USB
	default n

config RTCONFIG_DISK_MONITOR
	bool "Disk monitor Support"
	depends on RTCONFIG_USB
	default n

config RTCONFIG_USB_PRINTER
	bool "USB Printer Support"
	depends on RTCONFIG_USB
	default n

config RTCONFIG_USB_MODEM
	bool "USB Modem Support"
	depends on RTCONFIG_USB
	default n

config RTCONFIG_USB_LESSMODEM
	bool "Less USB Modem Support"
	depends on RTCONFIG_USB_MODEM
	default n

config RTCONFIG_USB_MODEM_PIN
	bool "USB Modem pin code Support"
	depends on RTCONFIG_USB_MODEM
	default n

config RTCONFIG_USB_BECEEM
	bool "BECEEM USB dongle Support"
	depends on RTCONFIG_USB_MODEM
	default n

config RTCONFIG_BRCM_USBAP
	bool "USB AP Support"
	depends on RTCONFIG_USB
	default n

config RTCONFIG_APP_PREINSTALLED
	bool "Preinstalled APP Packages Support"
	depends on RTCONFIG_USB
	default n

config RTCONFIG_APP_NETINSTALLED
	bool "Install APP Packages through Network Support"
	depends on RTCONFIG_USB
	default n

config RTCONFIG_APP_NOLOCALDM
	bool "Apps are preinstalled except for Downloadmaster"
	depends on RTCONFIG_APP_NETINSTALLED
	default n

config RTCONFIG_RALINK
	bool "Ralink Chip Support"
	default n

config RTCONFIG_RALINK_RT3883
	bool "Ralink Chip - RT3883 Support"
	depends on RTCONFIG_RALINK
	default n

config RTCONFIG_RALINK_RT3052
	bool "Ralink Chip - RT3052 Support"
	depends on RTCONFIG_RALINK
	default n

config RTCONFIG_RALINK_MT7620
	bool "Ralink Chip - MT7620 Support"
	depends on RTCONFIG_RALINK
	default n

config RTCONFIG_RALINK_MT7621
	bool "Ralink Chip - MT7621 Support"

config RTCONFIG_SPI_FAST_CLOCK
	bool "Ralink Chip - Double SPI clock"
	depends on RTCONFIG_RALINK
	default n

config RTCONFIG_EDCCA
	bool "Ralink Chip - EDCCA Monitor"
	depends on RTCONFIG_RALINK
	default n

config RTCONFIG_N56U_SR2
	bool "RT-N56U SR2 hardware support"
	depends on RTCONFIG_RALINK
	default n

config RTCONFIG_AP_CARRIER_DETECTION
	bool "Carrier Detection support"
	depends on RTCONFIG_RALINK
	default n

config RTCONFIG_LOCALE2012
	bool "Wireless Locale 2012"
	depends on RTCONFIG_RALINK_RT3883
	default n

config RTCONFIG_QCA
	bool "Qualcomm Atheros Chip Support"
	default n

config RTCONFIG_QCA953X
	bool "Qualcomm Atheros QCA953X Chip Support"
	default n

config RTCONFIG_QCA955X
	bool "Qualcomm Atheros QCA955X Chip Support"
	default n

config RTCONFIG_QCA956X
	bool "Qualcomm Atheros QCA956X Chip Support"
	default n

config RTCONFIG_QCA_PLC_UTILS
	bool "Qualcomm Atheros Powerline Toolkit Support"
	default n

config RTCONFIG_AR7420
	bool "Qualcomm Atheros AR7420 Powerline Chip Support"
	default n

config RTCONFIG_QCA7500
	bool "Qualcomm Atheros QCA7500 Powerline Chip Support"
	default n

config RTCONFIG_DEFAULT_AP_MODE
	bool "Default is AP mode"
	default n

config RTCONFIG_ODMPID
	bool "ODM Product ID"
	default n

config RTCONFIG_TIMEMACHINE
	bool "Timemachine Support"
	default n

config RTCONFIG_MDNS
	bool "MDNS Support"
	default n

config RTCONFIG_FINDASUS
	bool "FINDASUS Support"
	default n

config RTCONFIG_REDIRECT_DNAME
	bool "Redirect domain name Support"
	default n

config RTCONFIG_DHCP_OVERRIDE
	bool "DHCP override for AP/Repeater mode"
	depends on RTCONFIG_REDIRECT_DNAME
	default n

config RTCONFIG_MTK_TW_AUTO_BAND4
	bool "Choose BAND4 for auto channel"
	default n

config RTCONFIG_QCA_TW_AUTO_BAND4
	bool "Choose BAND4 for auto channel"
	default n

config RTCONFIG_LED_ALL
	bool "LED All GPIO"
	default n

config RTCONFIG_COMA
	bool "COMA"
	default n

config CONFIG_LIBBCM
	bool "Broadcom shared library functions"
	default n

config CONFIG_LIBUPNP
	bool "BCM UPnP library"
	default n

config RTCONFIG_WPS
	bool "WPS Support"
	default y

config RTCONFIG_WPS_ENROLLEE
	bool "WPS Enrolle Support"
	default n

config RTCONFIG_WIFI_CLONE
	bool "WiFi Clone Support"
	depends on RTCONFIG_WPS_ENROLLEE
	default n

config RTCONFIG_SHP
	bool "Special Handler Process"
	default n

config RTCONFIG_SFP
	bool "Small Footprint"
	default n

config RTCONFIG_STRACE
	bool "strace"
	default n

config RTCONFIG_4M_SFP
	bool "Small Footprint: 4MB Flash"
	default n

config RTCONFIG_8M_SFP
	bool "Small Footprint: 8MB Flash"
	default n

config RTCONFIG_16M_RAM_SFP
	bool "Small Footprint: 16MB RAM"
	default n

config RTCONFIG_GROCTRL
	bool "GRO Control"
	default n

config RTCONFIG_LANWAN_LED
	bool "SW Control LAN/WAN LED"
	default n

config RTCONFIG_WLAN_LED
	bool "SW Control WLAN LED"
	default n

config RTCONFIG_FAKE_ETLAN_LED
	bool "SW Control LAN LED"
	default n

config RTCONFIG_EXT_LED_WPS
	bool "used to standalone WPS LED(not POWER LED)"
	default n

config RTCONFIG_SWMODE_SWITCH
	bool "HW Switch for SWMODE"
	default n

config RTCONFIG_WL_AUTO_CHANNEL
	bool "New auto_channel selection"
	default n

config RTCONFIG_SMALL_FW_UPDATE
	bool "used for memory limited model"
	default n

config RTCONFIG_WIRELESS_SWITCH
	bool "HW Switch for WiFi"
	default n

config RTCONFIG_WIFI_TOG_BTN
	bool "HW Button for WiFi toggle"
	default n

config RTCONFIG_WPS_RST_BTN
	bool "HW Button for WPS and Restore dual function"
	default n

config RTCONFIG_WPS_ALLLED_BTN
	bool "HW Button for WPS and LED dual function"
	default n

config RTCONFIG_TURBO
	bool "HW Turbo Btn"
	default n

config RTCONFIG_LED_BTN
	bool "HW LED Button"
	default n

config RTCONFIG_LED_BTN_MODE
	bool "HW LED Button Mode"
	depends on RTCONFIG_LED_BTN
	default n

config RTCONFIG_USBEJECT
	bool "HW LED Button usage"
	default n

config RTCONFIG_AUTODICT
	bool "AUTO DICTIONARY TOOLS"
	default n

config RTCONFIG_AUTOLIVEUPDATE_ZIP
	bool "AUTO Live update with ZIP method"
	default n

config RTCONFIG_ISP_METER
	bool "ISP_METER"
	default n

config RTCONFIG_NVRAM_64K
	bool "NVRAM_64K"
	default n

config RTCONFIG_GDB
	bool "GDB"
	default n

config RTCONFIG_USB_XHCI
	bool "XHCI"
	default n

config RTCONFIG_WLMODULE_RT3090_AP
	bool "Wireless module RT3090 ap"
	default n

config RTCONFIG_WLMODULE_RT3352_INIC_MII
	bool "Wireless module RT3352 iNIC MII"
	default n

config RTCONFIG_WLMODULE_MT7610_AP
	bool "Wireless module MT7610 ap"
	default n

config RTCONFIG_WLMODULE_RLT_WIFI
	bool "Wireless module RLT WIFI"
	default n

config RTCONFIG_WLMODULE_MT7603E_AP
	bool "Wireless module MT7603E ap"
	default n

config RTCONFIG_PSISTLOG
	bool "Persistent syslog"
	default n

config RTCONFIG_DUAL_TRX
	bool "DUAL_TRX"
	default n

config RTCONFIG_UBI
	bool "Unsorted Block Images"
	default n

config RTCONFIG_UBIFS
	bool "UBI File-System"
	default n

config RTCONFIG_OPTIMIZE_XBOX
	bool "OPTIMIZE_XBOX"
	default n

config RTCONFIG_NEW_REGULATION_DOMAIN
	bool "New Regulation Domain"
	default n

config RTCONFIG_DYN_DICT_NAME
	bool "DYN_DICT_NAME"
	default n

config RTCONFIG_LAN4WAN_LED
	bool "SW Control 4LAN/WAN LED"
	default n

config RTCONFIG_EXT4FS
	bool "ext4 filesystem"
	default n

config RTCONFIG_DMALLOC
	bool "dmalloc"
	default n

config RTCONFIG_JFFS2ND_BACKUP
	bool "backup some data to Read-only 2ND JFFS Partition"
	default n

config RTCONFIG_TEMPROOTFS
	bool "temp rootfilesystem"
	default n

config RTCONFIG_ATEUSB3_FORCE
	bool "ATE USB3 control"
	default n

config RTCONFIG_JFFS2LOG
	bool "Backup syslog to jffs2"
	depends on RTCONFIG_JFFS2 || RTCONFIG_BRCM_NAND_JFFS2
	default n

config RTCONFIG_WPSMULTIBAND
	bool "Multi-band WPS"
	default n

config RTCONFIG_RALINK_DFS
	bool "Rlink DFS support"
	default n

config RTCONFIG_ENGINEERING_MODE
	bool "Engineering Mode"
	default n

config RTCONFIG_VPNC
	bool "VPNC"
	default n

config RTCONFIG_KYIVSTAR
	bool "KYIVSTAR specified"
	default n

config RTCONFIG_ETRON_XHCI
	bool "Etron XHCI chip support"
	default n

config RTCONFIG_ETRON_XHCI_USB3_LED
	bool "USB3 LED wired to ETRON XHCI chip"
	default n

config RTCONFIG_WPS_LED
	bool "Individual WPS LED"
	default n

config RTCONFIG_MMC_LED
	bool "Individual MMC LED"
	default n

config RTCONFIG_RESET_SWITCH
	bool "reset switch"
	default n

config RTCONFIG_WANRED_LED
	bool "WAN RED LED"
	default n

config RTCONFIG_BLINK_LED
	bool "Blink LED(s)"
	default n

config RTCONFIG_CFE_NVRAM_CHK
	bool "CFE_NVRAM_CHK"
	default n

config RTCONFIG_DEBUG
	bool "debug mode"
	default n

config RTCONFIG_LLDP
	bool "lldpd"
	default n

config RTCONFIG_HAS_5G
	bool "has 5G band"
	default y

config RTCONFIG_DNSFILTER
	bool "DNS-based filtering Support"
	depends on !RTCONFIG_YANDEXDNS
	default n

config RTCONFIG_TFTP
	bool "TFTP server or client"
	default n

config RTCONFIG_QTN
	bool "Quantenna boot-code and firmware"
	default n

config RTCONFIG_RGMII_BRCM5301X
	bool "Config 5301x to RGMII mode"
	default n

config RTCONFIG_WPS_DUALBAND
	bool "Config WPS DUALBAND"
	default n

config RTCONFIG_N18UTXBF
	bool "enable TXBF for RT-N18U"
	default n

config RTCONFIG_BWDPI
	bool "TrendMicro DPI engine and iQoS and Partenl Control"
	default n

config RTCONFIG_ADBLOCK
	bool "Streaming and Pop-Up window Ad Blocking "
	default n

config RTCONFIG_TRAFFIC_CONTROL
	bool "Traffic control for alert limited traffic"
	default n

config RTCONFIG_CTF_PPTP_L2TP
	bool "Speedup NAT for PPTP and L2TP"
	default n
	
config RTCONFIG_BCM5301X_TRAFFIC_MONITOR
	bool "read BCM5301x register for traffic monitor"
	default n

config RTCONFIG_SPEEDTEST
	bool "BRCM Speedtest for detect upload / downlad bandwidth "
	default n

config RTCONFIG_BONDING
	bool "Linux Net Bonding"
	default n

config RTCONFIG_UIDEBUG
	bool "Enable UI debug mode"
	default n

config RTCONFIG_ROG
	bool "Get APP Traffic from ROG client"
	default n

config RTCONFIG_GEOIP
	bool "determine country by IP address"
	default n

config RTCONFIG_TRANSMISSION
	bool "Transmission A Fast, Easy and Free BitTorrent client"
	default n

config RTCONFIG_NOWL
	bool "no load wl module (only dhd test)"
	default n

config RTCONFIG_TCODE
	bool "Territory code"
	default y

config RTCONFIG_ALLNOWL
	bool "no load all wl module "
	default n

config RTCONFIG_WIFILOGO
	bool "building for Wi-Fi certification"
	default n

config RTCONFIG_JFFS2USERICON
	bool "Client list user upload icon"
	default n

config RTCONFIG_EXT_RTL8365MB
	bool "rtl8365mb driver flag"

config RTCONFIG_TOR
	bool "The orion router function"
	default n

config RTCONFIG_TR069
	bool "TR-069 agent"
	default n

config RTCONFIG_TR181
	bool "Support TR-181 data model"
	default n

config RTCONFIG_STAINFO
	bool "STA informtion support"
	default n
config RTCONFIG_CLOUDCHECK
	bool "Cloudcheck support"
	default n

config RTCONFIG_GETREALIP
	bool "Get external IP support"
	default n

config RTCONFIG_TUNNEL
	bool "TUNNEL config"
	default n

config RTCONFIG_CFEZ
	bool "compressed cfe"
	default n

config RTCONFIG_RESTRICT_GUI
	bool "Restrict GUI"
	default n

config RTCONFIG_LACP
	bool "LACP support"
	default n

config RTCONFIG_KEY_GUARD
	bool "Key Guard support"
	default n

config RTCONFIG_RECVFILE
	bool "Bcm recvfile support"
	default n

config RTCONFIG_WTFAST
        bool "WTFast support"
        default n

config RTCONFIG_ERP_TEST
	bool "erp test"
	default n

config RTCONFIG_REBOOT_SCHEDULE
	bool "Reboot_schedule"
	default n
```
