## release/src-rt-7.x.main/src/linux/linux-2.6.36/drivers/mtd/bcm947xx/nand/Kconfig
```kconfig
#
# linux/drivers/mtd/bcm947xx/nand/Kconfig
#

config MTD_BRCMNAND
	tristate "Broadcom NAND Device Support"
	default n
	depends on MTD
	depends on MTD_NAND
	help
	  This enables support for accessing selected types of NAND flash
	  devices through the Broadcom NAND controller.

config MTD_NFLASH
	bool "Broadcom Flash support for legacy MTD partition"
	help
	  This enables support for Broadcom legacy MTD partition.

config LINUX_MTD
	int "Linux MTD size (MB)"
	default "32"
	help
	  This can change MTD SIZE (MB), ASUS support!
```

## release/src-rt-7.x.main/src/linux/linux-2.6.36/sound/soc/bcm947xx/Kconfig
```kconfig
config SND_BCM947XX_SOC
        tristate "SoC Audio for the BCM947xx System-on-Chip"
        depends on BCM947XX && SND_SOC
        help
          Say Y or M if you want to add support for I2S bus interface in the SOC as
	  well as any codecs on the board.
	  You will also need to select the audio interfaces to support below.
```

## release/src-rt/linux/linux-2.6/drivers/mtd/47xxnand/Kconfig
```kconfig
#
# linux/drivers/mtd/47xxnand/Kconfig
#

config MTD_BRCMNAND
	tristate "Broadcom NAND Device Support"
	default n
	depends on MTD
	help
	  This enables support for accessing selected types of NAND flash
	  devices through the Broadcom NAND controller.
```

## release/src-rt/linux/linux-2.6/drivers/usb/Beceem_driver/Kconfig
```kconfig
#
# USB modem driver of Beceem configuration
#
comment "USB modem driver of Beceem"
	depends on USB

config USB_BECEEM
	tristate "Beceem's WiMAX Modem support"
	depends on USB
	---help---
	  This driver supports USB WiMAX modems of Beceem.
```

## release/src-rt/linux/linux-2.6/sound/soc/codecs/Kconfig
```kconfig
config SND_SOC_AC97_CODEC
	tristate
	depends on SND_SOC

config SND_SOC_WM8731
	tristate
	depends on SND_SOC

config SND_SOC_WM8750
	tristate "WM8750"
	depends on SND_SOC

config SND_SOC_WM8753
	tristate
	depends on SND_SOC

config SND_SOC_WM8955
	tristate "WM8955"
	depends on SND_SOC

config SND_SOC_WM9712
	tristate
	depends on SND_SOC
```
