## release/src/router/ipset/kernel/Kconfig.ipset
```kconfig
config IP_NF_SET
	tristate "IP set support"
	depends on INET && NETFILTER
	help
	  This option adds IP set support to the kernel.
	  In order to define and use sets, you need the userspace utility
	  ipset(8).

	  To compile it as a module, choose M here.  If unsure, say N.

config IP_NF_SET_MAX
	int "Maximum number of IP sets"
	default 256
	range 2 65534
	depends on IP_NF_SET
	help
	  You can define here default value of the maximum number 
	  of IP sets for the kernel.

	  The value can be overriden by the 'max_sets' module
	  parameter of the 'ip_set' module.

config IP_NF_SET_HASHSIZE
	int "Hash size for bindings of IP sets"
	default 1024
	depends on IP_NF_SET
	help
	  You can define here default value of the hash size for
	  bindings of IP sets.

	  The value can be overriden by the 'hash_size' module
	  parameter of the 'ip_set' module.

config IP_NF_SET_IPMAP
	tristate "ipmap set support"
	depends on IP_NF_SET
	help
	  This option adds the ipmap set type support.

	  To compile it as a module, choose M here.  If unsure, say N.

config IP_NF_SET_MACIPMAP
	tristate "macipmap set support"
	depends on IP_NF_SET
	help
	  This option adds the macipmap set type support.

	  To compile it as a module, choose M here.  If unsure, say N.

config IP_NF_SET_PORTMAP
	tristate "portmap set support"
	depends on IP_NF_SET
	help
	  This option adds the portmap set type support.

	  To compile it as a module, choose M here.  If unsure, say N.

config IP_NF_SET_IPHASH
	tristate "iphash set support"
	depends on IP_NF_SET
	help
	  This option adds the iphash set type support.

	  To compile it as a module, choose M here.  If unsure, say N.

config IP_NF_SET_NETHASH
	tristate "nethash set support"
	depends on IP_NF_SET
	help
	  This option adds the nethash set type support.

	  To compile it as a module, choose M here.  If unsure, say N.

config IP_NF_SET_IPPORTHASH
	tristate "ipporthash set support"
	depends on IP_NF_SET
	help
	  This option adds the ipporthash set type support.

	  To compile it as a module, choose M here.  If unsure, say N.

config IP_NF_SET_IPPORTIPHASH
	tristate "ipportiphash set support"
	depends on IP_NF_SET
	help
	  This option adds the ipportiphash set type support.

	  To compile it as a module, choose M here.  If unsure, say N.

config IP_NF_SET_IPPORTNETHASH
	tristate "ipportnethash set support"
	depends on IP_NF_SET
	help
	  This option adds the ipportnethash set type support.

	  To compile it as a module, choose M here.  If unsure, say N.

config IP_NF_SET_IPTREE
	tristate "iptree set support"
	depends on IP_NF_SET
	help
	  This option adds the iptree set type support.

	  To compile it as a module, choose M here.  If unsure, say N.

config IP_NF_SET_IPTREEMAP
	tristate "iptreemap set support"
	depends on IP_NF_SET
	help
	  This option adds the iptreemap set type support.

	  To compile it as a module, choose M here.  If unsure, say N.

config IP_NF_SET_SETLIST
	tristate "setlist set support"
	depends on IP_NF_SET
	help
	  This option adds the setlist set type support.

	  To compile it as a module, choose M here.  If unsure, say N.

config IP_NF_MATCH_SET
	tristate "set match support"
	depends on IP_NF_SET
	help
	  Set matching matches against given IP sets.
	  You need the ipset utility to create and set up the sets.

	  To compile it as a module, choose M here.  If unsure, say N.

config IP_NF_TARGET_SET
	tristate "SET target support"
	depends on IP_NF_SET
	help
	  The SET target makes possible to add/delete entries
	  in IP sets.
	  You need the ipset utility to create and set up the sets.

	  To compile it as a module, choose M here.  If unsure, say N.
```

## release/src/router/ipset_arm/kernel/net/netfilter/Kconfig.ipset
```kconfig
menu "Core Netfilter Configuration"
	depends on NET && INET && NETFILTER

if NETFILTER_XTABLES

config NETFILTER_XT_SET
	tristate 'set target and match support'
	depends on IP_SET
	depends on NETFILTER_ADVANCED
	help
	  This option adds the "SET" target and "set" match.

	  Using this target and match, you can add/delete and match
	  elements in the sets created by ipset(8).

	  To compile it as a module, choose M here.  If unsure, say N.

endif # NETFILTER_XTABLES

endmenu

source "net/netfilter/ipset/Kconfig"
```

## release/src/router/xl2tpd/packaging/openwrt/Config.in
```kconfig
config BR2_PACKAGE_XL2TPD
	tristate "Xl2tpd - an L2TP daemon for use with IPsec"
	select BR2_PACKAGE_OPENSWAN
	default m if CONFIG_DEVEL
	help
	  Xl2tpd is an L2TP implementation for use with IPsec
	  
	  http://www.xelerance.com/software/xl2tpd/
	  
```

## toolchain/Config.in
```kconfig
# Copyright (C) 2006-2007 OpenWrt.org
#
# This is free software, licensed under the GNU General Public License v2.
# See /LICENSE for more information.
#

mainmenu "OpenWrt Configuration"

config HAVE_DOT_CONFIG
	bool
	default y

#source "target/Config.in"

config TARGET_BOARD
        string
	default "brcm-2.4"

config LINUX_2_4
        bool
	default y

config mipsel
        bool
	default y

config ARCH
        string
        default "arm"     if arm
        default "armeb"   if armeb
        default "avr32"   if avr32
        default "cris"    if cris
        default "i386"    if i386
        default "i686"    if i686
        default "m68k"    if m68k
        default "mips"    if mips
        default "mipsel"  if mipsel
        default "powerpc" if powerpc
        default "sh3"     if sh3
        default "sh3eb"   if sh3eb
        default "sh4"     if sh4
        default "sh4eb"   if sh4eb
        default "sparc"   if sparc
        default "x86_64"  if x86_64


config ALL
	bool "Select all packages by default"
	default n

menuconfig DEVEL
	bool "Advanced configuration options (for developers)"
	default n
	select BUILDOPTS
	select TOOLCHAINOPTS if !NATIVE_TOOLCHAIN

config BROKEN
	bool
	prompt "Show broken platforms / packages" if DEVEL
	default n

config LOCALMIRROR
	string
	prompt "Local mirror for source packages" if DEVEL

menuconfig BUILDOPTS
	bool
	prompt "Build Options" if DEVEL

config AUTOREBUILD
	bool
	prompt "Automatic rebuild of packages" if BUILDOPTS
	default y
	help
		Automatically rebuild packages when their files change

config BUILD_SUFFIX
	string
	prompt "Build suffix to append to the BUILD_DIR variable" if BUILDOPTS
	default ""
	help
		Build suffix to append to the BUILD_DIR variable, i.e: build_dir_suffix

config TAR_VERBOSITY
	bool 
	prompt "Tar verbose" if BUILDOPTS
	default n

config CCACHE
	bool
	prompt "Use ccache" if BUILDOPTS
	default n
	help
		Compiler cache; see http://ccache.samba.org/

config EXTERNAL_KERNEL_TREE
	string
	prompt "Use external kernel tree" if DEVEL
	default ""

config BUILD_DEVELOPER_SYSTEM
	bool "build a non-stripped system, so gcc can be run natively on target" if DEVEL
	default n

source "toolchain/Config.in"
menuconfig BUILDSYSTEM_SETTINGS
    bool "Buildsystem settings" 

config DOWNLOAD_FOLDER
	string
	prompt "Download folder"
	default ""
	depends BUILDSYSTEM_SETTINGS 
#source "target/imagebuilder/Config.in"
#source "target/sdk/Config.in"

#source "tmp/.config-package.in"
```
